## conf/layer.conf
```bitbake
BBFILES += "${LAYERDIR}/recipes/*/*.bb ${LAYERDIR}/recipes/*/*.bbappend"
BBPATH .= ":${LAYERDIR}"
BBFILE_COLLECTIONS += "qti-robos"
BBFILE_PRIORITY_qti-robos = "17"
BBFILE_PATTERN_qti-robos := "^${LAYERDIR}/"
LAYERSERIES_COMPAT_qti-robos = "kirkstone scarthgap wrynose"
```
